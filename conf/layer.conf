## conf/layer.conf
```bitbake
# We have a conf and classes directory, add to BBPATH
BBPATH .= ":${LAYERDIR}"

# We have recipes-* directories, add to BBFILES
BBFILES += "${LAYERDIR}/recipes-*/*/*.bb \
            ${LAYERDIR}/recipes-*/*/*.bbappend"

BBFILE_COLLECTIONS += "meta-customdock"
BBFILE_PATTERN_meta-customdock = "^${LAYERDIR}/"
BBFILE_PRIORITY_meta-customdock = "8"

LAYERDEPENDS_meta-customdock = "core"
LAYERSERIES_COMPAT_meta-customdock = "kirkstone"
```
